## base_external/package/aesdchar-driver/Config.in
```kconfig
config BR2_PACKAGE_AESDCHAR_DRIVER
	bool "aesdchar-driver"
	help
	  Includes the aesdchar-driver.c aesdchar-driver.ko to the package.
	  Used to understand buildroot external trees and package builds.
```

## base_external/package/ldd/Config.in
```kconfig
config BR2_PACKAGE_LDD
	bool "ldd"
	help
	  Includes the hello.c hello.ko to the package.
	  Used to understand buildroot external trees and package builds.
```
